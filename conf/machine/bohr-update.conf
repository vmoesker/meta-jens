## conf/machine/bohr-update.conf
```bitbake
#@NAME: ARM based Marvell Sheevaplug

include conf/machine/bohr.conf

UBOOT_ENTRYPOINT := "0x00008000"
UBOOT_LOADADDRESS := "0x00008000"

IMAGE_FSTYPES := "ext2"

WANTED_ROOT_DEV ??= "usb"

PACKAGE_ARCHS_append = " bohr_update-usb"

SOC_FAMILY_append = "bohr-update"

KERNEL_IMAGETYPE = "uImage"

VIRTUAL-RUNTIME_dev_manager = ""

# tunable variable for possible later optimization
# IMAGE_ROOTFS_EXTRA_SPACE = "71680"
IMAGE_ROOTFS_SIZE = "286720"
```

## conf/machine/bohr.conf
```bitbake
#@NAME: ARM based Marvell Sheevaplug

include conf/machine/include/kirkwood.inc

include conf/machine/include/u-boot-bohr-2015.07-1.0.inc
include conf/machine/include/linux-bohr-4.1-1.0.inc

IMAGE_FSTYPES = "tar.bz2 squashfs-xz"

IMAGE_FEATURES_remove = " splash "

# + nfs ?
AVAIL_ROOT_DEVS = "usb nand"
INTERNAL_ROOT_DEV = "nand"
WANTED_ROOT_DEV ??= "${INTERNAL_ROOT_DEV}"

ROOT_DEV_NAME-nand = "ubi0"
ROOT_DEV_SEP-nand = "_"
ROOT_DEV_TYPE-nand = "mtd"
ROOT_DEV_NAME-usb = "sda"
ROOT_DEV_SEP-usb = ""
ROOT_DEV_TYPE-usb = "ssd"

ROOT_DEV_NAME = "${ROOT_DEV_NAME-${WANTED_ROOT_DEV}}"
ROOT_DEV_SEP = "${ROOT_DEV_SEP-${WANTED_ROOT_DEV}}"
ROOT_DEV_TYPE = "${ROOT_DEV_TYPE-${WANTED_ROOT_DEV}}"

PACKAGE_ARCHS_append = " bohr-usb bohr-nand bohr-nfs"

SOC_FAMILY = "marvell,kirkwood-88f6281:marvell,kirkwood:kirkwood:bohr"

MACHINE_FIRMWARE_append = " linux-firmware-sd8686 linux-firmware-sd8787"
MACHINE_EXTRA_RRECOMMENDS = " kernel-modules ${MACHINE_FIRMWARE}"

PREFERRED_PROVIDER_virtual/bootloader = "u-boot"
PREFERRED_PROVIDER_virtual/kernel = "linux-${MACHINE}"

PREFERRED_PROVIDER_jpeg = "libjpeg-turbo"
PREFERRED_PROVIDER_jpeg-native = "libjpeg-turbo-native"

DISTRO_FEATURES_remove = " alsa opengl ppp"

PACKAGECONFIG_append_pn-openjre-8 = " zero "
PACKAGECONFIG_append_pn-openjdk-8 = " zero "
#PACKAGECONFIG_append_pn-openjdk-8 = " shark "

# Machine-specific features
MACHINE_FEATURES_remove = " phone irda usbgadget 3g nfc pcmcia touchscreen mmc "
MACHINE_FEATURES_append = " pci usbhost ext2 vfat wifi bluetooth "
```

## conf/machine/curie.conf
```bitbake
#@TYPE: Machine
#@NAME: curie
#@SOC: i.MX6SL
#@DESCRIPTION: Machine configuration for curie systems

include conf/machine/include/imx-base.inc
include conf/machine/include/tune-cortexa9.inc

#include conf/machine/include/u-boot-2009.08.inc
#include conf/machine/include/u-boot-2013.04.inc
#include conf/machine/include/u-boot-2014.04.inc
include conf/machine/include/u-boot-2015.04.inc
#include conf/machine/include/linux-3.0-4.1.inc
#include conf/machine/include/linux-3.10-1.0.inc
#include conf/machine/include/linux-3.14-1.0.inc
include conf/machine/include/linux-4.1-1.0.inc

IMAGE_FSTYPES = "tar.bz2 squashfs-xz"

# + nfs ?
AVAIL_ROOT_DEVS = "usb sd emmc"
INTERNAL_ROOT_DEV = "emmc"
WANTED_ROOT_DEV ??= "${INTERNAL_ROOT_DEV}"

ROOT_DEV_NAME-emmc = "mmcblk${KERNEL_MMC_DEV-emmc}"
ROOT_DEV_SEP-emmc = "p"
ROOT_DEV_TYPE-emmc = "ssd"
ROOT_DEV_NAME-sd = "mmcblk${KERNEL_MMC_DEV-sd}"
ROOT_DEV_SEP-sd = "p"
ROOT_DEV_TYPE-sd = "ssd"
ROOT_DEV_NAME-usb = "sda"
ROOT_DEV_SEP-usb = ""
ROOT_DEV_TYPE-usb = "ssd"

ROOT_DEV_NAME = "${ROOT_DEV_NAME-${WANTED_ROOT_DEV}}"
ROOT_DEV_SEP = "${ROOT_DEV_SEP-${WANTED_ROOT_DEV}}"
ROOT_DEV_TYPE = "${ROOT_DEV_TYPE-${WANTED_ROOT_DEV}}"

SOC_FAMILY = "mx6:mx6q:curie:mx6qcurie"

# Ship all kernel modules by default
MACHINE_EXTRA_RRECOMMENDS = " kernel-modules kernel-module-8189es ${MACHINE_FIRMWARE} "

SERIAL_CONSOLE = "115200 ttymxc0"

# Uncomment the following line to enable the hard floating point abi. Note that
# this breaks some binary libraries and 3D (neither of which ship with
# meta-yocto). For maximum compatibility, leave this disabled.
DEFAULTTUNE ?= "cortexa9hf-neon"

PREFERRED_PROVIDER_u-boot = "u-boot-${MACHINE}"
PREFERRED_PROVIDER_virtual/kernel = "linux-${MACHINE}"

PREFERRED_PROVIDER_jpeg = "libjpeg-turbo"
PREFERRED_PROVIDER_jpeg-native = "libjpeg-turbo-native"

PREFERRED_PROVIDER_ffmpeg = "ffmpeg"
PREFERRED_PROVIDER_virtual/egl = "gpu-viv-bin-mx6q"
PREFERRED_PROVIDER_virtual/libgles2 = "gpu-viv-bin-mx6q"
PREFERRED_PROVIDER_virtual/libg2d = "gpu-viv-g2d"
PREFERRED_PROVIDER_virtual/fftw = "fftwf"

DISTRO_FEATURES_remove = " bluetooth bluez5 pci "
DISTRO_FEATURES_append = " opengl "

PACKAGECONFIG_append_pn-openjre-8 = " zero "
PACKAGECONFIG_append_pn-openjdk-8 = " zero "
#PACKAGECONFIG_append_pn-openjdk-8 = " shark "

MACHINE_FEATURES_remove = " bluetooth phone irda usbgadget 3g nfc pci apm acpi pcmcia touchscreen "
MACHINE_FEATURES_append = " usbhost alsa wifi"
```

## conf/machine/include/curie.inc
```bitbake
require conf/machine/include/imx-base.inc
require conf/machine/include/tune-cortexa9.inc

# Uncomment the following line to enable the hard floating point abi. Note that
# this breaks some binary libraries and 3D (neither of which ship with
# meta-yocto). For maximum compatibility, leave this disabled.
DEFAULTTUNE ?= "cortexa9hf-neon"

# generate tar only
IMAGE_FSTYPES += "tar.bz2 squashfs-xz"

# Ship all kernel modules by default
MACHINE_EXTRA_RRECOMMENDS = " kernel-modules"
MACHINE_FIRMWARE =+ " firmware-imx-vpu-imx6q "

# 2.6.37 and later kernels use OMAP_SERIAL, ttyO2
# earlier kernels use ttyS2
SERIAL_CONSOLE = "115200 ttymxc0"

PREFERRED_PROVIDER_u-boot = "u-boot-curie"
PREFERRED_PROVIDER_virtual/kernel = "linux-curie"

MACHINE_FEATURES_remove = " phone irda usbgadget 3g nfc "
DISTRO_FEATURES_remove = " phone irda usbgadget 3g nfc "
MACHINE_FEATURES_append = " alsa pci wifi"
DISTRO_FEATURES_append = " wifi"
```

## conf/machine/include/kirkwood.inc
```bitbake
TARGET_ARCH = "arm"
DEFAULTTUNE = "arm926ejs"

require conf/machine/include/tune-arm926ejs.inc
```

## conf/machine/include/linux-3.0-4.1.inc
```bitbake
PREFERRED_VERSION_linux-curie = "3.0.35"

UBOOT_ENTRYPOINT = "0x10800000"
UBOOT_LOADADDRESS = "0x10800000"

PREFERRED_VERSION_firmware-imx = "3.0.35-4.0.0"
PREFERRED_VERSION_imx-lib = "3.10.9-1.0.0"
PREFERRED_VERSION_imx-vpu = "3.10.9-1.0.0"
PREFERRED_VERSION_gpu-viv-bin-mx6q = "3.10.9-1.0.0-hfp"

OVERLAYFS = "#overlayfs"
UNIONFS = "none"

# 2.6.37 and later kernels use OMAP_SERIAL, ttyO2
# earlier kernels use ttyS2
SERIAL_CONSOLE = "115200 ttymxc0"
KERNEL_MMC_BASE_DEV = "0"

KERNEL_MMC_DEV = "${@${KERNEL_MMC_BASE_DEV}+${SDCARD_IMAGE}}"
KERNEL_EMMC_DEV = "${KERNEL_MMC_BASE_DEV}"
KERNEL_SD_DEV = "${@${KERNEL_MMC_BASE_DEV}+1}"
```

## conf/machine/include/linux-3.10-1.0.inc
```bitbake
#PREFERRED_VERSION_linux-curie = "3.10.17"
PREFERRED_VERSION_linux-curie = "3.10.80"

UBOOT_ENTRYPOINT = "0x17800000"
UBOOT_LOADADDRESS = "0x12000000"
UBOOT_FDTADDRESS = "0x18000000"

PREFERRED_VERSION_firmware-imx = "3.10.17-1.0.0"
PREFERRED_VERSION_imx-lib = "3.10.17-1.0.0"
PREFERRED_VERSION_imx-vpu = "3.10.17-1.0.0"
PREFERRED_VERSION_gpu-viv-bin-mx6q = "3.10.17-1.0.1-hfp"
PREFERRED_VERSION_gpu-viv-bin-mx6dl = "3.10.17-1.0.1-hfp"

OVERLAY = "#overlay"
OVERLAYFS = "overlayfs"
UNIONFS = "#unionfs"
UNION_SHADOWS=".shadow/.etc .shadow/.home"

# 2.6.37 and later kernels use OMAP_SERIAL, ttyO2
# earlier kernels use ttyS2
SERIAL_CONSOLE = "115200 ttymxc0"

# kernel device tree
KERNEL_DEVICETREE = "imx6q-curie.dtb"
KERNEL_MMC_BASE_DEV = "2"

KERNEL_MMC_DEV = "${@${KERNEL_MMC_BASE_DEV}-${SDCARD_IMAGE}}"
KERNEL_EMMC_DEV = "${KERNEL_MMC_BASE_DEV}"
KERNEL_SD_DEV = "${@${KERNEL_MMC_BASE_DEV}-1}"
```

## conf/machine/include/linux-3.14-1.0.inc
```bitbake
PREFERRED_VERSION_linux-curie = "3.14.28"

UBOOT_ENTRYPOINT = "0x17800000"
UBOOT_LOADADDRESS = "0x12000000"
UBOOT_FDTADDRESS = "0x18000000"

PREFERRED_VERSION_firmware-imx = "3.14.28-1.0.0"
PREFERRED_VERSION_imx-lib = "3.10.53-1.1.0"
PREFERRED_VERSION_imx-vpu = "5.4.28"
PREFERRED_VERSION_gpu-viv-bin-mx6q = "5.0.11.p4.5-hfp"
PREFERRED_VERSION_gpu-viv-bin-mx6dl = "5.0.11.p4.5-hfp"

OVERLAYFS = "overlayfs"
UNIONFS = "#unionfs"

# 2.6.37 and later kernels use OMAP_SERIAL, ttyO2
# earlier kernels use ttyS2
SERIAL_CONSOLE = "115200 ttymxc0"

# kernel device tree
KERNEL_DEVICETREE = "imx6q-curie.dtb"
KERNEL_MMC_BASE_DEV = "2"

KERNEL_MMC_DEV = "${@${KERNEL_MMC_BASE_DEV}-${SDCARD_IMAGE}}"
KERNEL_EMMC_DEV = "${KERNEL_MMC_BASE_DEV}"
KERNEL_SD_DEV = "${@${KERNEL_MMC_BASE_DEV}-1}"
```

## conf/machine/include/linux-4.1-1.0.inc
```bitbake
PREFERRED_VERSION_linux-curie = "4.1"

UBOOT_ENTRYPOINT = "0x17800000"
UBOOT_LOADADDRESS = "0x12000000"
UBOOT_FDTADDRESS = "0x18000000"

PREFERRED_VERSION_firmware-imx = "5.0"
PREFERRED_VERSION_imx-lib = "5.1"
PREFERRED_VERSION_imx-vpu = "5.4.31"
PREFERRED_VERSION_gpu-viv-bin-mx6q = "5.0.11.p6.3-hfp"
PREFERRED_VERSION_gpu-viv-bin-mx6dl = "5.0.11.p6.3-hfp"

OVERLAY = "overlay"
OVERLAYFS = "#overlayfs"
UNIONFS = "#unionfs"
UNION_SHADOWS=".shadow/.etc .shadow/.home"

# 2.6.37 and later kernels use OMAP_SERIAL, ttyO2
# earlier kernels use ttyS2
SERIAL_CONSOLE = "115200 ttymxc0"

# kernel device tree
KERNEL_DEVICETREE = "imx6q-curie.dtb"
KERNEL_MMC_BASE_DEV = "3"

KERNEL_MMC_DEV-emmc = "3"
KERNEL_MMC_DEV-sd = "2"
KERNEL_MMC_DEV = "${KERNEL_MMC_DEV-${WANTED_ROOT_DEV}}"
```

## conf/machine/include/linux-bohr-4.1-1.0.inc
```bitbake
#@TYPE: Machine
#@DESCRIPTION: Machine configuration for various different Marvell Kirkwood based devices

OVERLAY = "overlay"
OVERLAYFS = "#overlayfs"
UNIONFS = "#unionfs"
UNION_SHADOWS=".shadow/.etc .shadow/.home .work/.etc .work/.home"

SERIAL_CONSOLE = "115200 ttyS0"
KERNEL_IMAGETYPE ?= "zImage"
KERNEL_DEVICETREE = "kirkwood-guruplug-server-plus.dtb"

UBOOT_ENTRYPOINT = "0x800000"
UBOOT_LOADADDRESS = "0x800000"
UBOOT_FDTADDRESS = "0x700000"

REFERRED_VERSION_linux-bohr = "4.1"
```

## conf/machine/include/u-boot-2009.08.inc
```bitbake
PREFERRED_VERSION_u-boot-curie = "2009.08"

UBOOT_MACHINE = "mx6q_sabresd_config"

UBOOT_SUFFIX = "bin"
UBOOT_PADDING = "2"
UBOOT_MMC_DEV-emmc = "3"
UBOOT_MMC_DEV-sd = "2"
UBOOT_MMC_DEV = "${UBOOT_MMC_DEV-${WANTED_ROOT_DEV}}"
```

## conf/machine/include/u-boot-2013.04.inc
```bitbake
PREFERRED_VERSION_u-boot-curie = "2013.04"
PREFERRED_VERSION_u-boot-fw-utils-curie = "2013.04"

UBOOT_MACHINE = "mx6qcurie"

UBOOT_MMC_DEV-emmc = "1"
UBOOT_MMC_DEV-sd = "0"
UBOOT_MMC_DEV = "${UBOOT_MMC_DEV-${WANTED_ROOT_DEV}}"
```

## conf/machine/include/u-boot-2014.04.inc
```bitbake
PREFERRED_VERSION_u-boot-curie = "2014.04"
PREFERRED_VERSION_u-boot-fw-utils-curie = "2014.04"

UBOOT_MACHINE = "mx6qcurie_config"

UBOOT_MMC_BASE_DEV = "1"
UBOOT_MMC_DEV = "${@${UBOOT_MMC_BASE_DEV}-${SDCARD_IMAGE}}"
```

## conf/machine/include/u-boot-bohr-2015.07-1.0.inc
```bitbake
PREFERRED_VERSION_u-boot = "v2015.07%"
PREFERRED_VERSION_u-boot-fw-utils = "v2015.07%"

UBOOT_MACHINE = "guruplug_config"
UBOOT_SUFFIX = "kwb"
UBOOT_MAKE_TARGET = "u-boot.kwb"
```

## conf/machine/include/u-boot-curie-2015.04.inc
```bitbake
PREFERRED_VERSION_u-boot-curie = "2015.04"
PREFERRED_VERSION_u-boot-fw-utils-curie = "2015.04"

UBOOT_MACHINE = "mx6qcurie_config"

UBOOT_MMC_DEV-emmc = "1"
UBOOT_MMC_DEV-sd = "0"
UBOOT_MMC_DEV = "${UBOOT_MMC_DEV-${WANTED_ROOT_DEV}}"
```

## conf/machine/mx6dlcurie.conf
```bitbake
#@TYPE: Machine
#@NAME: mx6dlcurie
#@SOC: i.MX6DL
#@DESCRIPTION: Machine configuration for curie systems

# soc family
SOC_FAMILY = "mx6:mx6dl:curie:mx6dlcurie"

# includes
require conf/machine/include/curie.inc

# u-boot machine
UBOOT_MACHINE = "mx6dlcurie"

# kernel device tree
KERNEL_DEVICETREE = "imx6dl-curie.dtb"
```

## conf/machine/mx6qcurie.conf
```bitbake
#@TYPE: Machine
#@NAME: mx6qcurie
#@SOC: i.MX6Q/D
#@DESCRIPTION: Machine configuration for curie systems

# soc family
SOC_FAMILY = "mx6:mx6q:curie:mx6qcurie"

# includes
require conf/machine/include/curie.inc

# u-boot machine
UBOOT_MACHINE = "mx6qcurie"

# kernel device tree
KERNEL_DEVICETREE = "imx6q-curie.dtb"
```
